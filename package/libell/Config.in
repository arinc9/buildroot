## package/libell/Config.in
```kconfig
config BR2_PACKAGE_LIBELL
	bool "libell"
	help
	  Embedded Linux library

	  https://git.kernel.org/pub/scm/libs/ell/ell.git
```

## package/mdio-tools/Config.in
```kconfig
config BR2_PACKAGE_MDIO_TOOLS
	bool "mdio-tools"
	depends on BR2_USE_MMU # fork()
	select BR2_PACKAGE_LIBMNL
	help
	  Low-level debug tools for MDIO devices.

	  https://github.com/wkz/mdio-tools
```

## package/mptcpd/Config.in
```kconfig
config BR2_PACKAGE_MPTCPD
	bool "mptcpd"
        select BR2_PACKAGE_LIBELL
	select BR2_PACKAGE_ARGP_STANDALONE \
		if BR2_TOOLCHAIN_USES_UCLIBC || BR2_TOOLCHAIN_USES_MUSL
	help
	  mptcpd

	  https://github.com/multipath-tcp/mptcpd
```
